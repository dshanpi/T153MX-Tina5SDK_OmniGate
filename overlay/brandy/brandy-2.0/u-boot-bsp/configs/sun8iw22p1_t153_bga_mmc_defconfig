## overlay/brandy/brandy-2.0/u-boot-bsp/configs/sun8iw22p1_t153_bga_mmc_defconfig
```kconfig
CONFIG_ARM=y
CONFIG_ARM_SMCCC=y
CONFIG_ARCH_SUNXI_ARM=y
CONFIG_TEXT_BASE=0x43500000
CONFIG_SYS_MALLOC_LEN=0x2800000
CONFIG_HAS_CUSTOM_SYS_INIT_SP_ADDR=y
CONFIG_CUSTOM_SYS_INIT_SP_ADDR=0x48000
CONFIG_ENV_SIZE=0x20000
CONFIG_DEFAULT_DEVICE_TREE="uboot-board"
CONFIG_MACH_SUN8IW22=y
# CONFIG_VIDEO_SUNXI is not set
CONFIG_SUNXI_FDT_ADDR=0x42000000
CONFIG_SYS_CUSTOM_LDSCRIPT=y
CONFIG_SYS_LDSCRIPT="bsp/arch/arm/mach-sunxi/u-boot.lds"
CONFIG_ANDROID_BOOT_IMAGE=y
CONFIG_PREBOOT=""
CONFIG_LOGLEVEL=6
# CONFIG_SYS_DEVICE_NULLDEV is not set
# CONFIG_LOG_CONSOLE is not set
CONFIG_BOARD_EARLY_INIT_F=y
CONFIG_SYS_MAXARGS=64
CONFIG_SYS_BOOTM_LEN=0x2000000
CONFIG_CMD_GPIO=y
CONFIG_CMD_LOG=y
# CONFIG_ENV_IS_IN_FAT is not set
CONFIG_CLK_CCF=y
CONFIG_CLK_COMPOSITE_CCF=y
# CONFIG_CLK_SUNXI is not set
CONFIG_DM_HASH=y
CONFIG_DM_MOD_EXP=y
CONFIG_MISC=y
CONFIG_MMC_BROKEN_CD=y
CONFIG_MMC_HS400_SUPPORT=y
# CONFIG_MMC_SUNXI is not set
CONFIG_RGMII=y
CONFIG_RMII=y
CONFIG_PINCONF=y
CONFIG_DM_PMIC=y
CONFIG_PMIC_AXP=y
CONFIG_DM_PWM=y
CONFIG_DM_USB_GADGET=y
CONFIG_USB_EHCI_HCD=y
# CONFIG_WDT_SUNXI is not set
CONFIG_RSA=y
# CONFIG_TOOLS_LIBCRYPTO is not set
CONFIG_AW_PINCTRL_V3=y
CONFIG_AW_GPIO=y
CONFIG_AW_GPIO_V3=y
CONFIG_AW_PWM=y
CONFIG_AW_USB=y
CONFIG_AW_EFEX=y
CONFIG_AW_BURN=y
CONFIG_AW_FASTBOOT=y
CONFIG_AW_UDC=y
CONFIG_AW_UDC_CONTROLLER=y
CONFIG_AW_USB_PHY=y
CONFIG_USB_EHCI_HCD_SUNXI=y
CONFIG_AW_DRM=y
CONFIG_AW_DRM_DSI=y
# CONFIG_AW_DRM_HDMI_TX is not set
# CONFIG_AW_DRM_EINK200 is not set
CONFIG_AW_DRM_PANEL=y
CONFIG_PANEL_DSI_GENERAL=y
CONFIG_AW_DRM_PHY=y
CONFIG_AW_CE_DRIVER=y
CONFIG_SUNXI_CE_23=y
CONFIG_AW_EFUSE=y
CONFIG_AW_DWMAC=y
CONFIG_CMD_SUNXI_TIMER=y
CONFIG_CMD_SUNXI_PRIVATE_STORAGE=y
CONFIG_CMD_SUNXI_EFEX=y
CONFIG_CMD_SUNXI_BURN=y
CONFIG_CMD_SUNXI_SPRITE=y
CONFIG_SUNXI_REDUNDAND_ENVIRONMENT=y
CONFIG_SYS_TEXT_BASE=0x43500000
CONFIG_SUNXI_PRIVATE_STORAGE=y
CONFIG_SUNXI_EXTERN_SECURE_MM_LAYOUT=y
CONFIG_SUNXI_BOOT_PARAM=y
# CONFIG_LOGF_MODULE is not set
# CONFIG_LOGF_LEVEL is not set
# CONFIG_LOGF_DEVNAME is not set
CONFIG_SUNXI_SPRITE_CARTOON=y
CONFIG_SUNXI_AUTO_UPDATE=y
CONFIG_VIDEO_LOGO=n
```

## overlay/buildroot/buildroot-202205/package/omnigate-core/Config.in
```kconfig
config BR2_PACKAGE_OMNIGATE_CORE
	bool "omnigate-core"
	depends on BR2_USE_WCHAR
	depends on BR2_USE_MMU
	depends on BR2_TOOLCHAIN_HAS_THREADS
	depends on !BR2_STATIC_LIBS
	select BR2_PACKAGE_PYTHON3
	select BR2_PACKAGE_PYTHON3_SQLITE
	select BR2_PACKAGE_PYTHON_FLASK
	help
	  Portable board manifest, industrial asset model, and versioned REST API
	  shared by OmniGate Lite and Enhanced gateway products.

comment "omnigate-core needs a toolchain w/ wchar, threads, dynamic library"
	depends on !BR2_USE_WCHAR || !BR2_TOOLCHAIN_HAS_THREADS || BR2_STATIC_LIBS
```

## overlay/buildroot/buildroot-202205/package/omnigate-ethercat/Config.in
```kconfig
config BR2_PACKAGE_OMNIGATE_ETHERCAT
	bool "omnigate-ethercat"
	depends on BR2_TOOLCHAIN_HAS_THREADS
	select BR2_PACKAGE_SOEM
	help
	  Structured EtherCAT diagnostics for the OmniGate management UI.
	  Provides slave inventory, CoE SDO upload/download and a bounded
	  cyclic process-data/WKC test on the dedicated EtherCAT interface.

comment "omnigate-ethercat needs a toolchain w/ threads"
	depends on !BR2_TOOLCHAIN_HAS_THREADS
```

## overlay/buildroot/buildroot-202205/package/omnigate-hmi/Config.in
```kconfig
config BR2_PACKAGE_OMNIGATE_HMI
	bool "omnigate-hmi"
	depends on BR2_PACKAGE_QT5
	select BR2_PACKAGE_QT5BASE_GUI
	select BR2_PACKAGE_QT5BASE_WIDGETS
	select BR2_PACKAGE_QT5BASE_NETWORK
	select BR2_PACKAGE_QT5CHARTS
	select BR2_PACKAGE_OMNIGATE_CORE
	help
	  Full-screen Qt5 industrial HMI for the T153MX OmniGate board.
```

## overlay/buildroot/buildroot-202205/package/python-jsonpath-rw/Config.in
```kconfig
config BR2_PACKAGE_PYTHON_JSONPATH_RW
	bool "python-jsonpath-rw"
	select BR2_PACKAGE_PYTHON_DECORATOR # runtime
	select BR2_PACKAGE_PYTHON_PLY # runtime
	select BR2_PACKAGE_PYTHON_SIX # runtime
	help
	  A robust and significantly extended implementation of JSONPath
	  for Python.

	  https://github.com/kennknowles/python-jsonpath-rw
```

## overlay/buildroot/buildroot-202205/package/soem/Config.in
```kconfig
config BR2_PACKAGE_SOEM
	bool "soem"
	depends on BR2_TOOLCHAIN_HAS_THREADS
	help
	  SOEM is a small, portable EtherCAT MainDevice (master) library.
	  This package installs libsoem and the upstream diagnostic/sample
	  programs, including slaveinfo, simple_ng and eepromtool.

	  https://github.com/OpenEtherCATsociety/SOEM

comment "soem needs a toolchain w/ threads"
	depends on !BR2_TOOLCHAIN_HAS_THREADS
```

## overlay/buildroot/buildroot-202205/package/thingsboard-gateway/Config.in
```kconfig
config BR2_PACKAGE_THINGSBOARD_GATEWAY
	bool "thingsboard-gateway"
	depends on BR2_PACKAGE_HOST_RUSTC_TARGET_ARCH_SUPPORTS
	select BR2_PACKAGE_PYTHON3
	select BR2_PACKAGE_PYTHON3_SSL
	select BR2_PACKAGE_PYTHON3_SQLITE
	select BR2_PACKAGE_PYTHON3_ZLIB
	select BR2_PACKAGE_PYTHON_CAN
	select BR2_PACKAGE_PYTHON_CRYPTOGRAPHY
	select BR2_PACKAGE_PYTHON_DATEUTIL
	select BR2_PACKAGE_PYTHON_JSONPATH_RW
	select BR2_PACKAGE_PYTHON_ORJSON
	select BR2_PACKAGE_PYTHON_PACKAGING
	select BR2_PACKAGE_PYTHON_PSUTIL
	select BR2_PACKAGE_PYTHON_PYSOCKS
	select BR2_PACKAGE_PYTHON_PYYAML
	select BR2_PACKAGE_PYTHON_REGEX
	select BR2_PACKAGE_PYTHON_REQUESTS
	select BR2_PACKAGE_PYTHON_SERIAL
	select BR2_PACKAGE_PYTHON_SERIAL_ASYNCIO
	select BR2_PACKAGE_PYTHON_SERVICE_IDENTITY
	select BR2_PACKAGE_PYTHON_SETUPTOOLS
	select BR2_PACKAGE_PYTHON_SIMPLEJSON
	help
	  ThingsBoard IoT Gateway with MQTT cloud transport and OmniGate
	  templates for one Modbus RTU and two SocketCAN/CAN-FD ports.

	  Runtime package installation is deliberately disabled. All required
	  modules are built into the firmware for reproducible deployments.

	  https://github.com/thingsboard/thingsboard-gateway

comment "thingsboard-gateway needs host Rust support for this target"
	depends on !BR2_PACKAGE_HOST_RUSTC_TARGET_ARCH_SUPPORTS
```
